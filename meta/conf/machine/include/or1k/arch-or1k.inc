## meta/conf/machine/include/or1k/arch-or1k.inc
```bitbake
# Architecture name
TUNE_ARCH = "or1k"

# Architecture feature and override
TUNEVALID[or1k] = "OpenRISC 1000"
MACHINEOVERRIDES =. "${@bb.utils.contains("TUNE_FEATURES", "or1k", "or1k:", "", d)}"

# General features
TUNEVALID[cmov] = "Enable l.cmov instruction"
TUNEVALID[ror] = "Enable l.rori instruction"
TUNEVALID[sign-extend] = "Enable sign-extension instructions"
TUNEVALID[setflag-imm] = "Enable set flag immediate instructions"
TUNEVALID[shift-imm] = "Enable shift and rotate immediate instructions"

# Feature compiler args
TUNE_CCARGS += "${@bb.utils.contains("TUNE_FEATURES", "cmov", "-mcmov", "", d)}"
TUNE_CCARGS += "${@bb.utils.contains("TUNE_FEATURES", "ror", "-mror", "", d)}"
TUNE_CCARGS += "${@bb.utils.contains("TUNE_FEATURES", "sign-extend", "-msext", "", d)}"
TUNE_CCARGS += "${@bb.utils.contains("TUNE_FEATURES", "setflag-imm", "-msfimm", "", d)}"
TUNE_CCARGS += "${@bb.utils.contains("TUNE_FEATURES", "shift-imm", "-mshftimm", "", d)}"


# math features
TUNEVALID[hard-multiply] = "Hardware multiply instructions"
TUNEVALID[hard-divide] = "Hardware divide instructions"

# Compiler args
TUNE_CCARGS += "${@bb.utils.contains('TUNE_FEATURES', 'hard-multiply', '-mhard-mul', '-msoft-mul', d)}"
TUNE_CCARGS += "${@bb.utils.contains('TUNE_FEATURES', 'hard-divide', '-mhard-div', '-msoft-div', d)}"

# default to soft FPU
TARGET_FPU = "fpu-soft"

# Feature package architecture formatting
TUNE_PKGARCH = "or1k"
TUNE_PKGARCH .= "${@bb.utils.contains("TUNE_FEATURES", "cmov", "c", "", d)}"
TUNE_PKGARCH .= "${@bb.utils.contains("TUNE_FEATURES", "ror", "r", "", d)}"
TUNE_PKGARCH .= "${@bb.utils.contains("TUNE_FEATURES", "sign-extend", "s", "", d)}"
TUNE_PKGARCH .= "${@bb.utils.contains("TUNE_FEATURES", "setflag-imm", "f", "", d)}"
TUNE_PKGARCH .= "${@bb.utils.contains("TUNE_FEATURES", "shift-imm", "i", "", d)}"
TUNE_PKGARCH .= "${@bb.utils.contains("TUNE_FEATURES", "hard-multiply", "-mul", "", d)}"
TUNE_PKGARCH .= "${@bb.utils.contains("TUNE_FEATURES", "hard-divide", "-div", "", d)}"
```

## meta/conf/machine/include/tune-or1k.inc
```bitbake
DEFAULTTUNE ?= "or1k"

require conf/machine/include/or1k/arch-or1k.inc

AVAILTUNES += "or1k"
TUNE_FEATURES_tune-or1k = "or1k"
PACKAGE_EXTRA_ARCHS_tune-or1k = "${TUNE_PKGARCH}"

AVAILTUNES += "or1ksim"
TUNE_FEATURES_tune-or1ksim = "or1k cmov ror sign-extend setflag-imm shift-imm hard-multiply hard-divide"
PACKAGE_EXTRA_ARCHS_tune-or1ksim = "${TUNE_PKGARCH}"
```

## meta/conf/machine/qemumicroblazeeb.conf
```bitbake
#@TYPE: Machine
#@NAME: petalogix-s3adsp1800
#@DESCRIPTION: MicroBlaze QEMU machine configuration ('petalogix-s3adsp1800' model)

require conf/machine/include/qemu.inc
require conf/machine/include/tune-microblaze.inc

TUNE_FEATURES_tune-microblaze += "v8.00 bigendian barrel-shift pattern-compare multiply-low"

MACHINE_FEATURES_BACKFILL_CONSIDERED += "rtc"
MACHINE_FEATURES = ""

USE_VT = ""
SERIAL_CONSOLE = "115200 ttyUL0"

# build uImage as the linux.bin needs to be loaded at an offset
KERNEL_IMAGETYPE = "uImage"
# MicroBlaze does not have a 'uImage' makefile target
KEEPUIMAGE = ""

# load kernel at base of RAM
UBOOT_LOADADDRESS = "0x90000000"
UBOOT_ENTRYPOINT = "${UBOOT_LOADADDRESS}"

# initramfs is preferred since this machine has no disk devices
IMAGE_FSTYPES += "cpio"

# This machine is a targeting a QEMU model, runqemu setup:
QB_SYSTEM_NAME = "qemu-system-microblaze"
QB_MEM = "-m 256"
QB_MACHINE = "-machine petalogix-s3adsp1800"
QB_KERNEL_CMDLINE_APPEND = "console=ttyUL0,115200"
QB_DEFAULT_FSTYPE = "cpio"
QB_OPT_APPEND = "-nographic -serial mon:stdio"
QB_NETWORK_DEVICE = "-net nic,netdev=net0,macaddr=@MAC@"
```

## meta/conf/machine/qemumicroblazeel.conf
```bitbake
#@TYPE: Machine
#@NAME: petalogix-ml605
#@DESCRIPTION: MicroBlaze QEMU machine configuration ('petalogix-ml605' model)

require conf/machine/include/qemu.inc
require conf/machine/include/tune-microblaze.inc

TUNE_FEATURES_tune-microblaze += "v8.50 barrel-shift reorder pattern-compare divide-hard multiply-high fpu-hard"

MACHINE_FEATURES_BACKFILL_CONSIDERED += "rtc"
MACHINE_FEATURES = ""

USE_VT = ""
SERIAL_CONSOLE = "115200 ttyS0"

# build uImage as the linux.bin needs to be loaded at an offset
KERNEL_IMAGETYPE = "uImage"
# MicroBlaze does not have a 'uImage' makefile target
KEEPUIMAGE = ""

# load kernel at base of RAM
UBOOT_LOADADDRESS = "0x50000000"
UBOOT_ENTRYPOINT = "${UBOOT_LOADADDRESS}"

# initramfs is preferred since this machine has no disk devices
IMAGE_FSTYPES += "cpio"

# This machine is a targeting a QEMU model, runqemu setup:
QB_SYSTEM_NAME = "qemu-system-microblazeel"
QB_MEM = "-m 256"
QB_MACHINE = "-machine petalogix-ml605"
QB_KERNEL_CMDLINE_APPEND = "console=ttyS0,115200"
QB_DEFAULT_FSTYPE = "cpio"
QB_OPT_APPEND = "-nographic -serial mon:stdio"
QB_NETWORK_DEVICE = "-net nic,netdev=net0,macaddr=@MAC@"
```

## meta/conf/machine/qemuor1k.conf
```bitbake
#@TYPE: Machine
#@NAME: qemuor1k
#@DESCRIPTION: OpenRISC OR1000 QEMU simulation machine ('or1k-sim')

DEFAULTTUNE ?= "or1ksim"
require conf/machine/include/tune-or1k.inc

KERNEL_IMAGETYPE = "vmlinux"
SERIAL_CONSOLES ?= "115200;ttyS0"

PREFERRED_PROVIDER_virtual/kernel ??= "linux-yocto"

IMAGE_FSTYPES += "cpio tar.bz2"

EXTRA_IMAGEDEPENDS += "qemu-native qemu-helper-native"
IMAGE_CLASSES += "qemuboot"

# For runqemu
QB_SYSTEM_NAME = "qemu-system-or1k"
QB_MACHINE = "-machine or1k-sim"
QB_DEFAULT_KERNEL = "${KERNEL_IMAGETYPE}-initramfs-${MACHINE}.bin"
QB_DEFAULT_FSTYPE = "none"
QB_ROOTFS = "none"
QB_OPT_APPEND = "-nographic -serial mon:stdio"
QB_NETWORK_DEVICE = "-net nic,netdev=net0,macaddr=@MAC@"
QB_KERNEL_CMDLINE_APPEND ?= ""

# glibc not upstream
TCLIBC = "musl"
```
